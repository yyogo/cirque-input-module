## drivers/input/Kconfig
```kconfig
# Copyright (c) 2022 The ZMK Contributors
# SPDX-License-Identifier: MIT

menuconfig INPUT_PINNACLE_TOUCAN
    bool "Cirque Pinnacle trackpads (Toucan fork)"
    default y
    depends on GPIO
    depends on SPI || I2C
    depends on INPUT
    depends on DT_HAS_CIRQUE_PINNACLE_TOUCAN_ENABLED
    help
      Enable the Toucan-forked Cirque Pinnacle trackpad driver. Distinct
      from Zephyr 4.1's upstream INPUT_PINNACLE driver; this fork uses
      compatible "cirque,pinnacle-toucan" and a different overlay
      property set (tap-fast, smoothing-strength, abs-rel-divisor, etc.).

if INPUT_PINNACLE_TOUCAN

config INPUT_PINNACLE_TOUCAN_INIT_PRIORITY
    int "Cirque Pinnacle initialization priority"
    default INPUT_INIT_PRIORITY

config INPUT_PINNACLE_TOUCAN_PROFILE_DUMP
    bool "Dump raw Pinnacle samples over the console (profiling mode)"
    default n
    help
      When enabled, the driver bypasses all post-processing
      (smoothing, abs-rel divisor, tap-fast, lookahead) and prints
      one CSV row per chip sample to the system console:
        t_ms,btn,x,y,z
      Forces the chip into absolute-mode reporting regardless of
      DT settings so the dump always carries raw positions. Intended
      for offline analysis of trackpad behavior; do not ship.

if ZMK_MOUSE

config ZMK_INPUT_PINNACLE_TOUCAN_IDLE_SLEEPER
    bool "Pinnacle Sleep linked to ZMK idle state"
    default n

endif

endif
```

## dts/bindings/input/cirque,pinnacle-common.yaml
```yaml
properties:
  dr-gpios:
    type: phandle-array
    description: Data ready pin for the trackpad
  rotate-90:
    type: boolean
  x-invert:
    type: boolean
  y-invert:
    type: boolean
  sleep:
    type: boolean
  no-secondary-tap:
    type: boolean
  no-taps:
    type: boolean
  disable-filter:
    type: boolean
    description: |
      Disable the on-chip IIR averaging filter (FEED_CFG1.DIS_FILT).
      Reduces cursor latency by ~10-20 ms at the cost of increased
      sample-to-sample jitter on slow movements.
  smoothing-strength:
    type: int
    default: 0
    description: |
      Velocity-adaptive smoothing applied in the driver after each
      report. 0 = disabled (passthrough). Values 2..16 attenuate slow
      motion by up to 1/N at zero velocity (sub-pixel remainder is
      retained), passing fast motion through unfiltered. Useful to
      cancel chip-level jitter when 'disable-filter' is set.
  sensitivity:
    type: string
    enum:
      - 1x
      - 2x
      - 3x
      - 4x
    description: ADC attenuation (sensitivity) setting.
  x-axis-z-min:
    type: int
    default: 5
  y-axis-z-min:
    type: int
    default: 4
  absolute-mode:
    type: boolean
  abs-rel-divisor:
    type: int
    description: If non zero, uses pad in absmode, but sends relative events (and touch press/release)
    default: 0
  absolute-mode-scale-to-width:
    type: int
    default: 1024
    description: Scale reported x values to [0-1024]
  absolute-mode-scale-to-height:
    type: int
    default: 1024
    description: Scale reported y values to [0-1024]
  absolute-mode-clamp-min-x:
    type: int
    default: 128
    description: |
      Specification says that active reporting of absolute position
      is: 128 ≤ X ≤1920 and 64 ≤ Y ≤ 1472, but on my touchpad, I need other values.
  absolute-mode-clamp-max-x:
    type: int
    default: 1920
    description: |
      Specification says that active reporting of absolute position
      is: 128 ≤ X ≤1920 and 64 ≤ Y ≤ 1472, but on my touchpad, I need other values.
  absolute-mode-clamp-min-y:
    type: int
    default: 64
    description: |
      Specification says that active reporting of absolute position
      is: 128 ≤ X ≤1920 and 64 ≤ Y ≤ 1472, but on my touchpad, I need other values.
  absolute-mode-clamp-max-y:
    type: int
    default: 1472
    description: |
      Specification says that active reporting of absolute position
      is: 128 ≤ X ≤1920 and 64 ≤ Y ≤ 1472, but on my touchpad, I need other values.
```

## dts/bindings/input/cirque,pinnacle-i2c.yaml
```yaml
description: |
  Sensor driver for the Cirque Pinnacle trackpad ASICs, using the I2C interface

compatible: "cirque,pinnacle-toucan"

include: ["i2c-device.yaml", "cirque,pinnacle-toucan-common.yaml"]
```

## dts/bindings/input/cirque,pinnacle-spi.yaml
```yaml
description: |
  Sensor driver for the Cirque Pinnacle trackpad ASICs, using the SPI interface

compatible: "cirque,pinnacle-toucan"

include: ["spi-device.yaml", "cirque,pinnacle-toucan-common.yaml"]
```

## dts/bindings/input/cirque,pinnacle-toucan-common.yaml
```yaml
properties:
  dr-gpios:
    type: phandle-array
    description: Data ready pin for the trackpad
  rotate-90:
    type: boolean
  x-invert:
    type: boolean
  y-invert:
    type: boolean
  sleep:
    type: boolean
  no-secondary-tap:
    type: boolean
  no-taps:
    type: boolean
  disable-filter:
    type: boolean
    description: |
      Disable the on-chip IIR averaging filter (FEED_CFG1.DIS_FILT).
      Reduces cursor latency by ~10-20 ms at the cost of increased
      sample-to-sample jitter on slow movements.
  smoothing-strength:
    type: int
    default: 0
    description: |
      Velocity-adaptive smoothing applied in the driver after each
      report. 0 = disabled (passthrough). Values 2..16 attenuate slow
      motion by up to 1/N at zero velocity (sub-pixel remainder is
      retained), passing fast motion through unfiltered. Useful to
      cancel chip-level jitter when 'disable-filter' is set.
  tap-fast:
    type: boolean
    description: |
      Bypass the chip's tap state machine (which adds ~200 ms of
      tap-confirmation latency) and emit BTN_PRIM press+release in
      the driver as soon as the touch state machine sees the lift,
      provided the touch was short and didn't drag. Implies the
      chip's DIS_TAP and DIS_SEC bits so the chip's own taps don't
      double-fire on top.
  lift-filter:
    type: boolean
    description: |
      Suppress lift-edge cursor jitter. After a touch has had real
      motion and then settled (small motion for ~30 ms), the driver
      zeros further motion below an 8-unit breakout threshold until
      either lift or a deliberate finger re-push. Filters out the
      centroid-shift artifact that rides through smoothing and the
      1-sample lookahead at lift, which would otherwise bump the
      cursor off whatever target the user just aimed at.
  sensitivity:
    type: string
    enum:
      - 1x
      - 2x
      - 3x
      - 4x
    description: ADC attenuation (sensitivity) setting.
  x-axis-z-min:
    type: int
    default: 5
  y-axis-z-min:
    type: int
    default: 4
  absolute-mode:
    type: boolean
  abs-rel-divisor:
    type: int
    description: If non zero, uses pad in absmode, but sends relative events (and touch press/release)
    default: 0
  absolute-mode-scale-to-width:
    type: int
    default: 1024
    description: Scale reported x values to [0-1024]
  absolute-mode-scale-to-height:
    type: int
    default: 1024
    description: Scale reported y values to [0-1024]
  absolute-mode-clamp-min-x:
    type: int
    default: 128
    description: |
      Specification says that active reporting of absolute position
      is: 128 ≤ X ≤1920 and 64 ≤ Y ≤ 1472, but on my touchpad, I need other values.
  absolute-mode-clamp-max-x:
    type: int
    default: 1920
    description: |
      Specification says that active reporting of absolute position
      is: 128 ≤ X ≤1920 and 64 ≤ Y ≤ 1472, but on my touchpad, I need other values.
  absolute-mode-clamp-min-y:
    type: int
    default: 64
    description: |
      Specification says that active reporting of absolute position
      is: 128 ≤ X ≤1920 and 64 ≤ Y ≤ 1472, but on my touchpad, I need other values.
  absolute-mode-clamp-max-y:
    type: int
    default: 1472
    description: |
      Specification says that active reporting of absolute position
      is: 128 ≤ X ≤1920 and 64 ≤ Y ≤ 1472, but on my touchpad, I need other values.
```
